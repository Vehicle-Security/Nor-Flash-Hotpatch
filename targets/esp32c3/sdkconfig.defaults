## targets/esp32s3/sdkconfig.defaults
```kconfig
CONFIG_FREERTOS_UNICORE=y
CONFIG_ESP_DEFAULT_CPU_FREQ_MHZ_240=y
CONFIG_PARTITION_TABLE_SINGLE_APP_LARGE=y
CONFIG_SPI_FLASH_DANGEROUS_WRITE_ALLOWED=y
```
